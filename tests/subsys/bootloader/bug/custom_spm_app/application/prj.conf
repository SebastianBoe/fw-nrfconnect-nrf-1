## CMakeLists.txt
```
#
# Copyright (c) 2018 Nordic Semiconductor
#
# SPDX-License-Identifier: LicenseRef-BSD-5-Clause-Nordic
#

cmake_minimum_required(VERSION 3.13.1)

list(APPEND ZEPHYR_EXTRA_MODULES
   ${CMAKE_CURRENT_SOURCE_DIR}/../spm_module)

find_package(Zephyr REQUIRED HINTS $ENV{ZEPHYR_BASE})
project(NONE)

# NORDIC SDK APP START
target_sources(app PRIVATE src/main.c)
# NORDIC SDK APP END
```

## prj.conf
```kconfig
CONFIG_SPM_BUILD_STRATEGY_SKIP_BUILD=y
CONFIG_SPM=y
CONFIG_ARM_FIRMWARE_USES_SECURE_ENTRY_FUNCS=y
CONFIG_ARM_ENTRY_VENEERS_LIB_NAME="spm/libspmsecureentries.a"
CONFIG_BUILD_WITH_TFM=n
CONFIG_FAULT_DUMP=2
CONFIG_RUNTIME_ERROR_CHECKS=y
CONFIG_HW_STACK_PROTECTION=y
CONFIG_REBOOT=n
CONFIG_PRINTK=y
CONFIG_RESET_ON_FATAL_ERROR=n
CONFIG_DEBUG_COREDUMP=n
CONFIG_DEBUG_COREDUMP_BACKEND_LOGGING=y
CONFIG_LOG=y
# DEBUG_COREDUMP_BACKEND_OTHER=n

CONFIG_NRF_ENABLE_ICACHE=n

CONFIG_PPI_TRACE=y

CONFIG_SIZE_OPTIMIZATIONS=n
CONFIG_NO_OPTIMIZATIONS=y
```

## src/main.c
```c
#include <zephyr/kernel.h>
#include <zephyr/sys/printk.h>
#include <stdio.h>
#include <secure_services.h>

#include <hal/nrf_rtc.h>
#include <hal/nrf_egu.h>


#include <debug/ppi_trace.h>


#define TIMER_PIN 10
#define EGU0_PIN 11
#define EGU1_PIN 12


bool rcrOtpRead_nse(uint8_t xField, uint8_t *xpDest, size_t *xpNumBytes);

bool rcrOtpRead(uint8_t xField, uint8_t *xpDest, size_t *xpNumBytes)
{
  bool retVal = false;
  //  unsigned int irqKey = 0u;

  before_nse();
 // irqKey = irq_lock();
  //  NRF_P0->OUTSET |= 1 << EGU1_PIN;
  retVal = rcrOtpRead_nse(xField, xpDest, xpNumBytes);
  //  NRF_P0->OUTCLR |= 1 << EGU1_PIN;
  after_nse();
 // irq_unlock(irqKey);
  return retVal;
}
static void my_timer_handler(struct k_timer *dummy)
{
	//	NRF_P0->OUTSET |= 1 << EGU0_PIN;
	printk("=");
	//	NRF_P0->OUTCLR |= 1 << EGU0_PIN;
}

static K_TIMER_DEFINE(my_timer, my_timer_handler, NULL);

static void conf(uint32_t pin, uint32_t evt)
{
	void *handle;

	handle = ppi_trace_config(pin, evt);
	__ASSERT(handle != NULL,
		"Failed to initialize trace pin, no PPI or GPIOTE resources?");

	ppi_trace_enable(handle);
}

void trace_enable(void) {
	conf(TIMER_PIN,
		 nrf_rtc_event_address_get(NRF_RTC1_NS, NRF_RTC_EVENT_COMPARE_0));

	NRF_P0->DIRSET |= 1 << EGU0_PIN;
	NRF_P0->DIRSET |= 1 << EGU1_PIN;
	NRF_P0->DIRSET |= 1 << 13;

	NRF_P0->OUTSET |= 1 << EGU0_PIN;
	for(volatile int i = 0; i < 1000; i++);
	NRF_P0->OUTCLR |= 1 << EGU0_PIN;

	NRF_P0->OUTSET |= 1 << EGU1_PIN;
	for(volatile int i = 0; i < 1000; i++);
	NRF_P0->OUTCLR |= 1 << EGU1_PIN;

		/* __NOP(); __NOP(); __NOP(); __NOP(); */
}

void main(void){
    printk("Hello World! %s\n", CONFIG_BOARD);

	trace_enable();

    k_timer_start(&my_timer, K_USEC(100), K_USEC(300));
    for (uint32_t idx = 0u; idx < 0xFFFFFF; idx++)
    {
      uint8_t store[8];
      size_t size;

      size = 4u;
      printk("+");
      if (!rcrOtpRead(1, store, &size))
      {
        break;
      }
      printk("-");
    }
}

int spm_request_random_number_nse(uint8_t *output, size_t len, size_t *olen)
{
	return 0;
}
```
