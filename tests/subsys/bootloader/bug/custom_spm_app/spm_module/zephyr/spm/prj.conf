## CMakeLists.txt
```
#
# Copyright (c) 2019 Nordic Semiconductor ASA
#
# SPDX-License-Identifier: LicenseRef-BSD-5-Clause-Nordic
#
cmake_minimum_required(VERSION 3.13.1)

find_package(Zephyr REQUIRED HINTS $ENV{ZEPHYR_BASE})
project(NONE)

zephyr_include_directories(
  kernel/include
  ${ARCH_DIR}/${ARCH}/include
)

list(APPEND spm_DTC_OVERLAY_FILE "/workspaces/recovrdevice_wsl_act/samples/custom_spm_app/spm_module/zephyr/spm/nrf9160dk_nrf9160.overlay")
add_compile_definitions(
  spm_DTC_OVERLAY_FILE=/workspaces/recovrdevice_wsl_act/samples/custom_spm_app/spm_module/zephyr/spm/nrf9160dk_nrf9160.overlay
    )
zephyr_library_sources(src/main.c)
```

## sample.yaml
```
sample:
  name: spm Sample
tests:
  samples.nrf9160.spm:
    build_only: true
    build_on_all: true
    platform_allow: nrf9160dk_nrf9160
    tags: ci_build
    extra_args: spm_DTC_OVERLAY_FILE="systick_enabled.overlay_"
```

## prj.conf
```kconfig
CONFIG_IS_SPM=y
CONFIG_FW_INFO=y
CONFIG_GPIO=n
CONFIG_ARM_FIRMWARE_HAS_SECURE_ENTRY_FUNCS=y
CONFIG_FAULT_DUMP=0
CONFIG_RUNTIME_ERROR_CHECKS=y
CONFIG_HW_STACK_PROTECTION=y
CONFIG_REBOOT=n
CONFIG_PRINTK=y
CONFIG_RESET_ON_FATAL_ERROR=n
CONFIG_DEBUG_COREDUMP=y
CONFIG_DEBUG_COREDUMP_BACKEND_LOGGING=y
CONFIG_LOG=y
#DEBUG_COREDUMP_BACKEND_OTHER=n
CONFIG_NRF_RTC_TIMER=n

CONFIG_NRF_TRACE_PORT=y

CONFIG_NRF_ENABLE_ICACHE=n
```

## nrf9160dk_nrf9160.overlay
```dts
/* Needed to get NRF_PWMn defined. */
&pwm1 {
	status = "okay";
};

&pwm2 {
	status = "okay";
};

&pwm3 {
	status = "okay";
};
&systick {
	status = "okay";
};
```

## src/main.c
```c
/*
 * Copyright (c) 2018 Nordic Semiconductor ASA.
 *
 * SPDX-License-Identifier: LicenseRef-BSD-5-Clause-Nordic
 */

#include <spm.h>
#include <aarch32/cortex_m/tz.h>
#include <stdio.h>
#include <secure_services.h>
#include <nrfx_nvmc.h>

__TZ_NONSECURE_ENTRY_FUNC
void rcrOtpRead_nse(size_t num)
{
  for (size_t i = 0; i < num; i++)
  {
    volatile uint32_t val32 = *(const uint32_t *)0xff8108;
    // volatile uint32_t val32 = *(const uint32_t *)0xff8;
  }
}


void main(void)
{
	spm_config();
	spm_jump();
}
```
