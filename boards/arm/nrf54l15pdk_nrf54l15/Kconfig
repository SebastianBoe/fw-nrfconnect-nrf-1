## boards/arm/nrf54l15pdk_nrf54l15/Kconfig
```kconfig
# nRF54L FPGA nRF54L15 board configuration

# Copyright (c) 2022 Nordic Semiconductor ASA
# SPDX-License-Identifier: LicenseRef-Nordic-5-Clause

choice PLATFORM
	prompt "Platform selection"
	default ASIC

config EMULATOR_FPGA
	bool "FPGA platform."
	imply CACHE

config EMULATOR_SYSTEMC
	bool "SystemC emulator platform."

config ASIC
	bool "ASIC"
	imply CACHE
	help
	  ASIC platform.

endchoice
```

## boards/arm/nrf54l15pdk_nrf54l15/nrf54l15dk_nrf54l15_cpuapp_defconfig
```kconfig
# Copyright (c) 2022 Nordic Semiconductor ASA
# SPDX-License-Identifier: LicenseRef-Nordic-5-Clause

CONFIG_SOC_SERIES_NRF54LX=y
CONFIG_SOC_NRF54L15=y
CONFIG_SOC_NRF54L15_CPUAPP=y
CONFIG_BOARD_NRF54L15DK_NRF54L15_CPUAPP=y

# Enable MPU
CONFIG_ARM_MPU=y

# Enable hardware stack protection
CONFIG_HW_STACK_PROTECTION=y

# Enable TrustZone-M
CONFIG_ARM_TRUSTZONE_M=y

# Enable Cache
CONFIG_CACHE_MANAGEMENT=y
CONFIG_EXTERNAL_CACHE=y

CONFIG_NRF_GRTC_TIMER=y
CONFIG_SYSTEM_CLOCK_WAIT=y

CONFIG_UART_CONSOLE=y
CONFIG_CONSOLE=y
CONFIG_SERIAL=y

CONFIG_PINCTRL=y

# Enable GPIO
CONFIG_GPIO=y

# Setup clocks
CONFIG_SOC_LFXO_CAP_INTERNAL=y
CONFIG_SOC_LFXO_CAP_INT_VALUE_X2=31
CONFIG_SOC_HFXO_CAP_INTERNAL=y
CONFIG_SOC_HFXO_CAP_INT_VALUE_X4=60

# TODO: Should be investigated and fixed, uarte limitation
CONFIG_SHELL_BACKEND_SERIAL_INTERRUPT_DRIVEN=n
```

## samples/bootloader/Kconfig
```kconfig
#
# Copyright (c) 2022 Nordic Semiconductor ASA
#
# SPDX-License-Identifier: LicenseRef-Nordic-5-Clause
#

menu "NSIB"

EXT_API = BL_STORAGE
id = 0x1300
flags = 1
ver = 1
source "${ZEPHYR_BASE}/../nrf/subsys/fw_info/Kconfig.template.fw_info_ext_api"

endmenu

menu "Zephyr Kernel"
source "Kconfig.zephyr"
endmenu
```

## samples/ironside_se/snapshot_capture_recover/build/Kconfig/arch/Kconfig
```kconfig
# Load Zephyr Arch Kconfig descriptions.
osource "/home/sebo/ncs/zephyr/arch/rx/Kconfig"
osource "/home/sebo/ncs/zephyr/arch/x86/Kconfig"
osource "/home/sebo/ncs/zephyr/arch/xtensa/Kconfig"
osource "/home/sebo/ncs/zephyr/arch/sparc/Kconfig"
osource "/home/sebo/ncs/zephyr/arch/riscv/Kconfig"
osource "/home/sebo/ncs/zephyr/arch/posix/Kconfig"
osource "/home/sebo/ncs/zephyr/arch/openrisc/Kconfig"
osource "/home/sebo/ncs/zephyr/arch/mips/Kconfig"
osource "/home/sebo/ncs/zephyr/arch/arm64/Kconfig"
osource "/home/sebo/ncs/zephyr/arch/arm/Kconfig"
osource "/home/sebo/ncs/zephyr/arch/arc/Kconfig"
```

## samples/ironside_se/snapshot_capture_recover/build/Kconfig/boards/Kconfig.defconfig.tmp
```kconfig
# Load Zephyr board defconfig descriptions.
osource "/home/sebo/ncs/zephyr/boards/nordic/nrf54h20dk/Kconfig.defconfig"
```

## samples/ironside_se/snapshot_capture_recover/build/Kconfig/boards/Kconfig.nrf54h20dk
```kconfig
# Load board Kconfig descriptions.
osource "/home/sebo/ncs/zephyr/boards/nordic/nrf54h20dk/Kconfig.nrf54h20dk"
```

## samples/ironside_se/snapshot_capture_recover/build/Kconfig/boards/Kconfig.sysbuild
```kconfig
# Load Sysbuild board Kconfig descriptions.
osource "/home/sebo/ncs/zephyr/boards/nordic/nrf54h20dk/Kconfig.sysbuild"
```

## samples/ironside_se/snapshot_capture_recover/build/snapshot_capture_recover/Kconfig/boards/Kconfig
```kconfig
# Load Zephyr board Kconfig descriptions.
osource "/home/sebo/ncs/zephyr/boards/nordic/nrf54h20dk/Kconfig"
config BOARD_REVISION_0_9_0
	def_bool y
```

## samples/ironside_se/snapshot_capture_recover/build/uicr/Kconfig/boards/Kconfig.tmp
```kconfig
# Load Zephyr board Kconfig descriptions.
osource "/home/sebo/ncs/zephyr/boards/nordic/nrf54h20dk/Kconfig"
```

## samples/ironside_se/snapshot_capture_recover/build/uicr/Kconfig/soc/Kconfig
```kconfig
# Load Zephyr SoC Kconfig descriptions.
osource "/home/sebo/ncs/zephyr/soc/xlnx/zynqmp/Kconfig"
osource "/home/sebo/ncs/zephyr/soc/xlnx/zynq7000/Kconfig"
osource "/home/sebo/ncs/zephyr/soc/xlnx/versalnet/Kconfig"
osource "/home/sebo/ncs/zephyr/soc/xlnx/versal2/Kconfig"
osource "/home/sebo/ncs/zephyr/soc/xlnx/versal/Kconfig"
osource "/home/sebo/ncs/zephyr/soc/xen/Kconfig"
osource "/home/sebo/ncs/zephyr/soc/wch/ch32v/Kconfig"
osource "/home/sebo/ncs/zephyr/soc/ti/simplelink/Kconfig"
osource "/home/sebo/ncs/zephyr/soc/ti/mspm0/Kconfig"
osource "/home/sebo/ncs/zephyr/soc/ti/lm3s6965/Kconfig"
osource "/home/sebo/ncs/zephyr/soc/ti/k3/Kconfig"
osource "/home/sebo/ncs/zephyr/soc/telink/tlsr/Kconfig"
osource "/home/sebo/ncs/zephyr/soc/syna/sr100/Kconfig"
osource "/home/sebo/ncs/zephyr/soc/starfive/jh71xx/Kconfig"
osource "/home/sebo/ncs/zephyr/soc/st/stm32/Kconfig"
osource "/home/sebo/ncs/zephyr/soc/snps/qemu_arc/Kconfig"
osource "/home/sebo/ncs/zephyr/soc/snps/nsim/arc_v/Kconfig"
osource "/home/sebo/ncs/zephyr/soc/snps/nsim/arc_classic/Kconfig"
osource "/home/sebo/ncs/zephyr/soc/snps/hsdk4xd/Kconfig"
osource "/home/sebo/ncs/zephyr/soc/snps/hsdk/Kconfig"
osource "/home/sebo/ncs/zephyr/soc/snps/emsk/Kconfig"
osource "/home/sebo/ncs/zephyr/soc/snps/emsdp/Kconfig"
osource "/home/sebo/ncs/zephyr/soc/snps/arc_iot/Kconfig"
osource "/home/sebo/ncs/zephyr/soc/silabs/Kconfig"
osource "/home/sebo/ncs/zephyr/soc/sifli/sf32/Kconfig"
osource "/home/sebo/ncs/zephyr/soc/sifive/sifive_freedom/Kconfig"
osource "/home/sebo/ncs/zephyr/soc/sensry/Kconfig"
osource "/home/sebo/ncs/zephyr/soc/rockchip/Kconfig"
osource "/home/sebo/ncs/zephyr/soc/renode/riscv_virtual/Kconfig"
osource "/home/sebo/ncs/zephyr/soc/renode/cortex_r8_virtual/Kconfig"
osource "/home/sebo/ncs/zephyr/soc/renesas/smartbond/Kconfig"
osource "/home/sebo/ncs/zephyr/soc/renesas/rz/Kconfig"
osource "/home/sebo/ncs/zephyr/soc/renesas/rx/Kconfig"
osource "/home/sebo/ncs/zephyr/soc/renesas/rcar/Kconfig"
osource "/home/sebo/ncs/zephyr/soc/renesas/ra/Kconfig"
osource "/home/sebo/ncs/zephyr/soc/realtek/fingerprint/Kconfig"
osource "/home/sebo/ncs/zephyr/soc/realtek/ec/Kconfig"
osource "/home/sebo/ncs/zephyr/soc/realtek/bee/Kconfig"
osource "/home/sebo/ncs/zephyr/soc/realtek/ameba/Kconfig"
osource "/home/sebo/ncs/zephyr/soc/raspberrypi/rpi_pico/Kconfig"
osource "/home/sebo/ncs/zephyr/soc/quicklogic/eos_s3/Kconfig"
osource "/home/sebo/ncs/zephyr/soc/qemu/virt_riscv/Kconfig"
osource "/home/sebo/ncs/zephyr/soc/qemu/or1k/Kconfig"
osource "/home/sebo/ncs/zephyr/soc/qemu/malta/Kconfig"
osource "/home/sebo/ncs/zephyr/soc/openisa/rv32m1/Kconfig"
osource "/home/sebo/ncs/zephyr/soc/openhwgroup/cva6/Kconfig"
osource "/home/sebo/ncs/zephyr/soc/oct/osd32mp15x/Kconfig"
osource "/home/sebo/ncs/zephyr/soc/nxp/s32/Kconfig"
osource "/home/sebo/ncs/zephyr/soc/nxp/rw/Kconfig"
osource "/home/sebo/ncs/zephyr/soc/nxp/mcx/Kconfig"
osource "/home/sebo/ncs/zephyr/soc/nxp/lpc/Kconfig"
osource "/home/sebo/ncs/zephyr/soc/nxp/layerscape/Kconfig"
osource "/home/sebo/ncs/zephyr/soc/nxp/kinetis/Kconfig"
osource "/home/sebo/ncs/zephyr/soc/nxp/imxrt/Kconfig"
osource "/home/sebo/ncs/zephyr/soc/nxp/imx/Kconfig"
osource "/home/sebo/ncs/zephyr/soc/nuvoton/numicro/Kconfig"
osource "/home/sebo/ncs/zephyr/soc/nuvoton/numaker/Kconfig"
osource "/home/sebo/ncs/zephyr/soc/nuvoton/npcx/Kconfig"
osource "/home/sebo/ncs/zephyr/soc/nuvoton/npcm/Kconfig"
osource "/home/sebo/ncs/zephyr/soc/nordic/Kconfig"
osource "/home/sebo/ncs/zephyr/soc/neorv32/Kconfig"
osource "/home/sebo/ncs/zephyr/soc/native/inf_clock/Kconfig"
osource "/home/sebo/ncs/zephyr/soc/microchip/sam/sama7/Kconfig"
osource "/home/sebo/ncs/zephyr/soc/microchip/sam/sam_d5x_e5x/Kconfig"
osource "/home/sebo/ncs/zephyr/soc/microchip/pic64/Kconfig"
osource "/home/sebo/ncs/zephyr/soc/microchip/pic32c/pic32cz_ca/Kconfig"
osource "/home/sebo/ncs/zephyr/soc/microchip/pic32c/pic32cx_sg/Kconfig"
osource "/home/sebo/ncs/zephyr/soc/microchip/pic32c/pic32cm_pl/Kconfig"
osource "/home/sebo/ncs/zephyr/soc/microchip/pic32c/pic32cm_jh/Kconfig"
osource "/home/sebo/ncs/zephyr/soc/microchip/miv/Kconfig"
osource "/home/sebo/ncs/zephyr/soc/microchip/mec/Kconfig"
osource "/home/sebo/ncs/zephyr/soc/mediatek/mt8xxx/Kconfig"
osource "/home/sebo/ncs/zephyr/soc/lowrisc/opentitan/Kconfig"
osource "/home/sebo/ncs/zephyr/soc/litex/litex_vexriscv/Kconfig"
osource "/home/sebo/ncs/zephyr/soc/ite/ec/Kconfig"
osource "/home/sebo/ncs/zephyr/soc/intel/wildcat_lake/Kconfig"
osource "/home/sebo/ncs/zephyr/soc/intel/raptor_lake/Kconfig"
osource "/home/sebo/ncs/zephyr/soc/intel/panther_lake/Kconfig"
osource "/home/sebo/ncs/zephyr/soc/intel/lakemont/Kconfig"
osource "/home/sebo/ncs/zephyr/soc/intel/intel_socfpga_std/Kconfig"
osource "/home/sebo/ncs/zephyr/soc/intel/intel_socfpga/Kconfig"
osource "/home/sebo/ncs/zephyr/soc/intel/intel_niosv/Kconfig"
osource "/home/sebo/ncs/zephyr/soc/intel/intel_ish/Kconfig"
osource "/home/sebo/ncs/zephyr/soc/intel/intel_adsp/Kconfig"
osource "/home/sebo/ncs/zephyr/soc/intel/elkhart_lake/Kconfig"
osource "/home/sebo/ncs/zephyr/soc/intel/atom/Kconfig"
osource "/home/sebo/ncs/zephyr/soc/intel/apollo_lake/Kconfig"
osource "/home/sebo/ncs/zephyr/soc/intel/alder_lake/Kconfig"
osource "/home/sebo/ncs/zephyr/soc/infineon/psoc4/Kconfig"
osource "/home/sebo/ncs/zephyr/soc/infineon/edge/Kconfig"
osource "/home/sebo/ncs/zephyr/soc/infineon/cat3/Kconfig"
osource "/home/sebo/ncs/zephyr/soc/infineon/cat1c/Kconfig"
osource "/home/sebo/ncs/zephyr/soc/infineon/cat1b/Kconfig"
osource "/home/sebo/ncs/zephyr/soc/infineon/cat1a/Kconfig"
osource "/home/sebo/ncs/zephyr/soc/gd/gd32/Kconfig"
osource "/home/sebo/ncs/zephyr/soc/gaisler/leon3/Kconfig"
osource "/home/sebo/ncs/zephyr/soc/gaisler/gr716a/Kconfig"
osource "/home/sebo/ncs/zephyr/soc/focaltech/Kconfig"
osource "/home/sebo/ncs/zephyr/soc/espressif/Kconfig"
osource "/home/sebo/ncs/zephyr/soc/ene/kb1200/Kconfig"
osource "/home/sebo/ncs/zephyr/soc/ene/kb106x/Kconfig"
osource "/home/sebo/ncs/zephyr/soc/elan/em32f967/Kconfig"
osource "/home/sebo/ncs/zephyr/soc/egis/Kconfig"
osource "/home/sebo/ncs/zephyr/soc/efinix/sapphire/Kconfig"
osource "/home/sebo/ncs/zephyr/soc/cdns/xtensa_sample_controller/Kconfig"
osource "/home/sebo/ncs/zephyr/soc/cdns/swerv/Kconfig"
osource "/home/sebo/ncs/zephyr/soc/cdns/sample_controller32/Kconfig"
osource "/home/sebo/ncs/zephyr/soc/cdns/dc233c/Kconfig"
osource "/home/sebo/ncs/zephyr/soc/brcm/bcmvk/Kconfig"
osource "/home/sebo/ncs/zephyr/soc/brcm/bcm2712/Kconfig"
osource "/home/sebo/ncs/zephyr/soc/brcm/bcm2711/Kconfig"
osource "/home/sebo/ncs/zephyr/soc/blackberry/qnxhv_vm/Kconfig"
osource "/home/sebo/ncs/zephyr/soc/bflb/Kconfig"
osource "/home/sebo/ncs/zephyr/soc/atmel/sam0/Kconfig"
osource "/home/sebo/ncs/zephyr/soc/atmel/sam/Kconfig"
osource "/home/sebo/ncs/zephyr/soc/aspeed/Kconfig"
osource "/home/sebo/ncs/zephyr/soc/arm/Kconfig"
osource "/home/sebo/ncs/zephyr/soc/arm/beetle/Kconfig"
osource "/home/sebo/ncs/zephyr/soc/antmicro/myra/Kconfig"
osource "/home/sebo/ncs/zephyr/soc/andestech/Kconfig"
osource "/home/sebo/ncs/zephyr/soc/amd/acp_6_0/Kconfig"
osource "/home/sebo/ncs/zephyr/soc/ambiq/Kconfig"
osource "/home/sebo/ncs/zephyr/soc/allwinner/sun8i_h3/Kconfig"
osource "/home/sebo/ncs/zephyr/soc/alif/ensemble/Kconfig"
osource "/home/sebo/ncs/zephyr/soc/aesc/Kconfig"
osource "/home/sebo/ncs/zephyr/soc/adi/max32/Kconfig"
osource "/home/sebo/ncs/nrf/soc/sercomm/nrf91/Kconfig"
osource "/home/sebo/ncs/nrf/soc/nordic/Kconfig"
```
