/*
 * Copyright (c) 2022 Nordic Semiconductor ASA
 *
 * SPDX-License-Identifier: LicenseRef-Nordic-5-Clause
 */

/dts-v1/;
#include <nordic_nrf_next/nrf54l15_cpuapp.dtsi>
#include "nrf54l15dk_nrf54l15_common.dts"

/ {
	chosen {
		zephyr,sram = &sram0_s;
		zephyr,flash = &rram0;
		zephyr,code-partition = &slot0_partition;
		zephyr,sram-secure-partition = &sram0_s;
	};
};
