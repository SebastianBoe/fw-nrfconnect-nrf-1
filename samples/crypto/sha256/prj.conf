## CMakeLists.txt
```
#
# Copyright (c) 2021 Nordic Semiconductor ASA
#
# SPDX-License-Identifier: LicenseRef-Nordic-5-Clause
#

cmake_minimum_required(VERSION 3.20.0)

find_package(Zephyr REQUIRED HINTS $ENV{ZEPHYR_BASE})

project(sha256)

target_sources(app PRIVATE
  src/main.c
  src/sdfw_psa_ns_api.c
  # tfm_crypto_api.c provides and serializes the PSA Crypto API.
  ${NRF_DIR}/../modules/tee/tf-m/trusted-firmware-m/interface/src/tfm_crypto_api.c
  )

target_include_directories(app PRIVATE
  # to get tfm_builtin_key_ids.h (and more?)
  ${NRF_DIR}/include/tfm
  src
  )
```

## sample.yaml
```
sample:
  description: |
    This sample demonstrates hash computation and verification using the SHA-256 hash algorithm.
  name: SHA-256 sample
tests:
  sample.sha256.cc3xx:
    sysbuild: true
    tags:
      - introduction
      - psa
      - cc3xx
      - sysbuild
      - ci_samples_crypto
    platform_allow:
      - nrf5340dk/nrf5340/cpuapp/ns
      - nrf5340dk/nrf5340/cpuapp
      - nrf9160dk/nrf9160/ns
      - nrf9160dk/nrf9160
      - nrf52840dk/nrf52840
      - nrf9161dk/nrf9161
      - nrf9161dk/nrf9161/ns
      - nrf9151dk/nrf9151
      - nrf9151dk/nrf9151/ns
    harness: console
    harness_config:
      type: multi_line
      regex:
        - ".*Example finished successfully!.*"
    timeout: 7
    integration_platforms:
      - nrf5340dk/nrf5340/cpuapp/ns
      - nrf5340dk/nrf5340/cpuapp
      - nrf9160dk/nrf9160/ns
      - nrf9160dk/nrf9160
      - nrf9161dk/nrf9161/ns
      - nrf9161dk/nrf9161
      - nrf52840dk/nrf52840
      - nrf9151dk/nrf9151
      - nrf9151dk/nrf9151/ns
  sample.sha256.oberon:
    sysbuild: true
    extra_args:
      - CONFIG_PSA_CRYPTO_DRIVER_OBERON=y
      - CONFIG_PSA_CRYPTO_DRIVER_CRACEN=n
    tags:
      - introduction
      - psa
      - oberon
      - sysbuild
      - ci_samples_crypto
    platform_allow:
      - nrf5340dk/nrf5340/cpunet
      - nrf54l15dk/nrf54l15/cpuapp
    harness: console
    harness_config:
      type: multi_line
      regex:
        - .*Example finished successfully!.*
    timeout: 7
    integration_platforms:
      - nrf5340dk/nrf5340/cpunet
      - nrf54l15dk/nrf54l15/cpuapp
  sample.sha256.cracen:
    sysbuild: true
    tags:
      - introduction
      - psa
      - cracen
      - sysbuild
      - ci_samples_crypto
    platform_allow:
      - nrf54l15dk/nrf54l15/cpuapp
      - nrf54l15dk/nrf54l15/cpuapp/ns
      - nrf54l15dk/nrf54l10/cpuapp
      - nrf54l15dk/nrf54l10/cpuapp/ns
      - nrf54l15dk/nrf54l05/cpuapp
      - nrf54ls05dk/nrf54ls05b/cpuapp
      - nrf54lm20dk/nrf54lm20a/cpuapp
      - nrf54lm20dk/nrf54lm20a/cpuapp/ns
      - nrf54lv10dk/nrf54lv10a/cpuapp
      - nrf54lv10dk/nrf54lv10a/cpuapp/ns
      - nrf54lv10dk@0.2.0/nrf54lv10a/cpuapp
      - nrf7120pdk/nrf7120/cpuapp
    harness: console
    harness_config:
      type: multi_line
      regex:
        - ".*Example finished successfully!.*"
    timeout: 7
    integration_platforms:
      - nrf54l15dk/nrf54l15/cpuapp
      - nrf54l15dk/nrf54l15/cpuapp/ns
      - nrf54l15dk/nrf54l10/cpuapp
      - nrf54l15dk/nrf54l10/cpuapp/ns
      - nrf54l15dk/nrf54l05/cpuapp
      - nrf54ls05dk/nrf54ls05b/cpuapp
      - nrf54lm20dk/nrf54lm20a/cpuapp
      - nrf54lm20dk/nrf54lm20a/cpuapp/ns
      - nrf54lv10dk/nrf54lv10a/cpuapp
      - nrf54lv10dk/nrf54lv10a/cpuapp/ns
      - nrf7120pdk/nrf7120/cpuapp
  # Build integration regression protection.
  sample.nrf_security.sha256.integration:
    sysbuild: true
    build_only: true
    extra_args: SB_CONFIG_BOOTLOADER_MCUBOOT=y
    platform_allow:
      - nrf5340dk/nrf5340/cpuapp/ns
      - nrf52840dk/nrf52840
      - nrf52833dk/nrf52833
    integration_platforms:
      - nrf5340dk/nrf5340/cpuapp/ns
      - nrf52840dk/nrf52840
      - nrf52833dk/nrf52833
    tags:
      - sysbuild
      - ci_samples_crypto
  sample.newlib_libc.sha256:
    sysbuild: true
    build_only: true
    extra_args: CONFIG_NEWLIB_LIBC=y
    platform_allow:
      - nrf5340dk/nrf5340/cpuapp/ns
      - nrf52840dk/nrf52840
      - nrf54h20dk/nrf54h20/cpuapp
    integration_platforms:
      - nrf5340dk/nrf5340/cpuapp/ns
      - nrf52840dk/nrf52840
      - nrf54h20dk/nrf54h20/cpuapp
    tags:
      - sysbuild
      - ci_samples_crypto
  sample.sha256.cracen.crypto_service:
    sysbuild: true
    tags:
      - introduction
      - psa
      - cracen
      - sysbuild
      - crypto
      - ci_samples_crypto
    platform_allow:
      - nrf54h20dk/nrf54h20/cpuapp
    harness: console
    harness_config:
      type: multi_line
      regex:
        - ".*Example finished successfully!.*"
    timeout: 7
    integration_platforms:
      - nrf54h20dk/nrf54h20/cpuapp
```

## prj.conf
```kconfig
#
# Copyright (c) 2024 Nordic Semiconductor ASA
#
# SPDX-License-Identifier: LicenseRef-Nordic-5-Clause
#
# The Zephyr CMSIS emulation assumes that ticks are ms, currently
CONFIG_SYS_CLOCK_TICKS_PER_SEC=1000

CONFIG_MAIN_STACK_SIZE=4096
CONFIG_HEAP_MEM_POOL_SIZE=4096

# Enable logging
CONFIG_CONSOLE=y
CONFIG_LOG=y

# Enable nRF Security backend for PSA Crypto API
CONFIG_NRF_SECURITY=y
CONFIG_MBEDTLS_PSA_CRYPTO_C=y

# Enable cryptographic features
CONFIG_PSA_WANT_ALG_SHA_256=y
CONFIG_PSA_WANT_ALG_SHA_512=y
```

## src/main.c
```c
/*
 * Copyright (c) 2021, 2025 Nordic Semiconductor ASA
 *
 * SPDX-License-Identifier: LicenseRef-Nordic-5-Clause
 */

#include <zephyr/kernel.h>
#include <zephyr/sys/printk.h>
#include <zephyr/sys/util.h>
#include <stdio.h>
#include <stdlib.h>
#include <string.h>
#include <psa/crypto.h>
#include <psa/crypto_extra.h>
#include <zephyr/logging/log.h>

#ifdef CONFIG_BUILD_WITH_TFM
#include <tfm_ns_interface.h>
#endif

#define APP_SUCCESS		(0)
#define APP_ERROR		(-1)
#define APP_SUCCESS_MESSAGE "Example finished successfully!"
#define APP_ERROR_MESSAGE "Example exited with error!"

#define PRINT_HEX(p_label, p_text, len)\
	({\
		LOG_INF("---- %s (len: %u): ----", p_label, len);\
		LOG_HEXDUMP_INF(p_text, len, "Content:");\
		LOG_INF("---- %s end  ----", p_label);\
	})

LOG_MODULE_REGISTER(sha256, LOG_LEVEL_DBG);

/* ====================================================================== */
/*				Global variables/defines for the SHA512 example			  */

#define NRF_CRYPTO_EXAMPLE_SHA512_TEXT_SIZE (200)
#define NRF_CRYPTO_EXAMPLE_SHA512_SIZE (64)

/* Below text is used as plaintext for computing/verifying the hash. */
static uint8_t m_plain_text[NRF_CRYPTO_EXAMPLE_SHA512_TEXT_SIZE] = {
	"Example string to demonstrate basic usage of SHA512."
	"That uses single and multi-part PSA crypto API's to "
	"perform a SHA-512 hashing operation. This text is longer "
	"to test the bug reproduction scenarios."
};

static uint8_t m_hash[NRF_CRYPTO_EXAMPLE_SHA512_SIZE];

/* ====================================================================== */

int crypto_init(void)
{
	psa_status_t status;

	/* Initialize PSA Crypto */
	status = psa_crypto_init();
	if (status != PSA_SUCCESS)
		return APP_ERROR;

	return APP_SUCCESS;
}

int hash_singlepart_sha512(void)
{
	uint32_t olen;
	psa_status_t status;

	LOG_INF("Hashing using SHA-512...");

	/* Calculate the SHA-512 hash */
	status = psa_hash_compute(
		PSA_ALG_SHA_512, m_plain_text, sizeof(m_plain_text), m_hash, sizeof(m_hash), &olen);
	if (status != PSA_SUCCESS) {
		LOG_INF("psa_hash_compute failed! (Error: %d)", status);
		return APP_ERROR;
	}

	LOG_INF("Hash computation successful!");
	PRINT_HEX("SHA-512 hash", m_hash, sizeof(m_hash));

	return APP_SUCCESS;
}

int hash_multipart_sha512(void)
{
	uint32_t olen;
	psa_status_t status;
	uint8_t *input_ptr = m_plain_text;
	psa_hash_operation_t hash_operation = {0};

	LOG_INF("Hashing using multi-part SHA-512...");

	/* Setup a multipart hash operation */
	status = psa_hash_setup(&hash_operation, PSA_ALG_SHA_512);
	if (status != PSA_SUCCESS) {
		LOG_ERR("Could not setup the hash operation! Error %d", status);
		return APP_ERROR;
	}


	/* Feed the chunks of the input data to the PSA driver */
	status = psa_hash_update(&hash_operation, input_ptr, 42);
	if (status != PSA_SUCCESS) {
		LOG_ERR("Could not hash the next chunk! Error %d", status);
		return APP_ERROR;

	}
	LOG_INF("Added %d bytes", 42);
	input_ptr += 42;


	status = psa_hash_update(&hash_operation, input_ptr, 58);
	if (status != PSA_SUCCESS) {
		LOG_ERR("Could not hash the next chunk! Error %d", status);
		return APP_ERROR;

	}
	LOG_INF("Added %d bytes", 58);
	input_ptr += 58;

	status = psa_hash_update(&hash_operation, input_ptr, 50);
	if (status != PSA_SUCCESS) {
		LOG_ERR("Could not hash the next chunk! Error %d", status);
		return APP_ERROR;

	}
	LOG_INF("Added %d bytes", 50);

	status = psa_hash_finish(&hash_operation, m_hash, sizeof(m_hash), &olen);
	if (status != PSA_SUCCESS) {
		LOG_ERR("Could not finish the hash operation! Error %d", status);
		return APP_ERROR;
	}

	LOG_INF("Hash computation successful!");
	PRINT_HEX("SHA-512 hash", m_hash, sizeof(m_hash));

	return APP_SUCCESS;
}

int verify_sha512(void)
{
	psa_status_t status;

	LOG_INF("Verifying the SHA-512 hash...");

	/* Verify the hash */
	status = psa_hash_compare(
		PSA_ALG_SHA_512, m_plain_text, sizeof(m_plain_text), m_hash, sizeof(m_hash));
	if (status != PSA_SUCCESS) {
		LOG_INF("psa_hash_compare failed! (Error: %d)", status);
		return APP_ERROR;
	}

	LOG_INF("SHA-512 verification successful!");

	return APP_SUCCESS;
}

/* Test case 1: Single call to psa_hash_update() with > 127 bytes */
int test_bug_single_update_over_127_bytes(void)
{
	uint32_t olen;
	psa_status_t status;
	psa_hash_operation_t hash_operation = {0};
	uint8_t test_data[200];
	uint8_t test_hash[NRF_CRYPTO_EXAMPLE_SHA512_SIZE];

	/* Initialize test data */
	memset(test_data, 0xAA, sizeof(test_data));

	LOG_INF("=== Test: Single psa_hash_update() with 200 bytes (should trigger bug) ===");

	/* Setup a multipart hash operation */
	status = psa_hash_setup(&hash_operation, PSA_ALG_SHA_512);
	if (status != PSA_SUCCESS) {
		LOG_ERR("Could not setup the hash operation! Error %d", status);
		return APP_ERROR;
	}

	/* This should trigger the bug: single update with 200 bytes (> 127) */
	status = psa_hash_update(&hash_operation, test_data, 200);
	if (status == PSA_ERROR_INVALID_ARGUMENT) {
		LOG_ERR("BUG REPRODUCED! psa_hash_update() returned PSA_ERROR_INVALID_ARGUMENT (-135)");
		LOG_ERR("This is the expected bug behavior for SHA-512 with > 127 bytes in single update");
		psa_hash_abort(&hash_operation);
		return APP_ERROR;
	} else if (status != PSA_SUCCESS) {
		LOG_ERR("psa_hash_update() failed with unexpected error: %d", status);
		psa_hash_abort(&hash_operation);
		return APP_ERROR;
	}

	LOG_INF("psa_hash_update() succeeded (bug not reproduced)");
	status = psa_hash_finish(&hash_operation, test_hash, sizeof(test_hash), &olen);
	if (status != PSA_SUCCESS) {
		LOG_ERR("Could not finish the hash operation! Error %d", status);
		return APP_ERROR;
	}

	return APP_SUCCESS;
}

/* Test case 2: Multiple calls to psa_hash_update() where accumulated bytes exceed 127 */
int test_bug_multiple_updates_exceed_127_bytes(void)
{
	uint32_t olen;
	psa_status_t status;
	psa_hash_operation_t hash_operation = {0};
	uint8_t test_data[200];
	uint8_t test_hash[NRF_CRYPTO_EXAMPLE_SHA512_SIZE];

	/* Initialize test data */
	memset(test_data, 0xBB, sizeof(test_data));

	LOG_INF("=== Test: Multiple psa_hash_update() calls totaling 200 bytes (should trigger bug) ===");

	/* Setup a multipart hash operation */
	status = psa_hash_setup(&hash_operation, PSA_ALG_SHA_512);
	if (status != PSA_SUCCESS) {
		LOG_ERR("Could not setup the hash operation! Error %d", status);
		return APP_ERROR;
	}

	/* First update: 100 bytes */
	status = psa_hash_update(&hash_operation, test_data, 100);
	if (status != PSA_SUCCESS) {
		LOG_ERR("First psa_hash_update() failed! Error %d", status);
		psa_hash_abort(&hash_operation);
		return APP_ERROR;
	}
	LOG_INF("Added %d bytes (total: 100)", 100);

	/* Second update: 100 bytes (total will be 200, which exceeds 127) */
	status = psa_hash_update(&hash_operation, test_data + 100, 100);
	if (status == PSA_ERROR_INVALID_ARGUMENT) {
		LOG_ERR("BUG REPRODUCED! psa_hash_update() returned PSA_ERROR_INVALID_ARGUMENT (-135)");
		LOG_ERR("This is the expected bug behavior for SHA-512 when accumulated bytes exceed 127");
		psa_hash_abort(&hash_operation);
		return APP_ERROR;
	} else if (status != PSA_SUCCESS) {
		LOG_ERR("psa_hash_update() failed with unexpected error: %d", status);
		psa_hash_abort(&hash_operation);
		return APP_ERROR;
	}

	LOG_INF("Added %d bytes (total: 200)", 100);
	LOG_INF("psa_hash_update() succeeded (bug not reproduced)");
	status = psa_hash_finish(&hash_operation, test_hash, sizeof(test_hash), &olen);
	if (status != PSA_SUCCESS) {
		LOG_ERR("Could not finish the hash operation! Error %d", status);
		return APP_ERROR;
	}

	return APP_SUCCESS;
}

int main(void)
{
	int status;

	LOG_INF("Starting SHA-512 example (bug reproduction test)...");

	status = crypto_init();
	if (status != APP_SUCCESS) {
		LOG_INF(APP_ERROR_MESSAGE);
		return APP_ERROR;
	}

	PRINT_HEX("Plaintext to hash", m_plain_text, sizeof(m_plain_text));

	status = hash_singlepart_sha512();
	if (status != APP_SUCCESS) {
		LOG_INF(APP_ERROR_MESSAGE);
		return APP_ERROR;
	}

	status = verify_sha512();
	if (status != APP_SUCCESS) {
		LOG_INF(APP_ERROR_MESSAGE);
		return APP_ERROR;
	}

	/* Reset the hash */
	memset(m_hash, 0, sizeof(m_hash));

	status = hash_multipart_sha512();
	if (status != APP_SUCCESS) {
		LOG_INF(APP_ERROR_MESSAGE);
		return APP_ERROR;
	}

	/* Test bug reproduction scenarios */
	LOG_INF("");
	LOG_INF("========================================");
	LOG_INF("Testing bug reproduction scenarios...");
	LOG_INF("========================================");

	status = test_bug_single_update_over_127_bytes();
	if (status == APP_ERROR) {
		LOG_INF("Bug reproduced in test case 1!");
	} else {
		LOG_INF("Test case 1 passed (bug not reproduced)");
	}

	status = test_bug_multiple_updates_exceed_127_bytes();
	if (status == APP_ERROR) {
		LOG_INF("Bug reproduced in test case 2!");
	} else {
		LOG_INF("Test case 2 passed (bug not reproduced)");
	}

	LOG_INF(APP_SUCCESS_MESSAGE);

	return APP_SUCCESS;
}
```

## src/sdfw_psa_ns_api.c
```c
#include <stdint.h>
#include <stdbool.h>

#include "psa/client.h"
#include "psa/error.h"

#include <zephyr/ipc/ipc_service.h>

#include <sdfw_psa_ipc_service.h>

static struct ipc_ept ept;

static int send(const void *data, size_t len)
{
	return ipc_service_send(&ept, data, len);
}

BUILD_ASSERT(4 == sizeof(psa_handle_t));
BUILD_ASSERT(4 == sizeof(int32_t));
BUILD_ASSERT(4 == sizeof(const psa_invec *));
BUILD_ASSERT(4 == sizeof(size_t));
BUILD_ASSERT(4 == sizeof(psa_outvec *));
BUILD_ASSERT(4 == sizeof(psa_status_t *));

psa_status_t psa_call(psa_handle_t handle, int32_t type,
                      const psa_invec *in_vec, size_t in_len,
                      psa_outvec *out_vec, size_t out_len)
{
	/* We have no need for this at this time */
	ARG_UNUSED(type);

	if(in_len > PSA_MAX_IOVEC ||
	   out_len > PSA_MAX_IOVEC) {
		return PSA_ERROR_PROGRAMMER_ERROR;
	}

    int32_t ret;
    psa_status_t status = PSA_ERROR_COMMUNICATION_FAILURE;

	uint32_t ipc_service_buf[SDFW_PSA_IPC_DATA_LEN];

	ipc_service_buf[0] = handle; /* i.e. TFM_CRYPTO_HANDLE defined to 0x40000100U */
	ipc_service_buf[1] = (uint32_t)in_vec;
	ipc_service_buf[2] = in_len;
	ipc_service_buf[3] = (uint32_t)out_vec;
	ipc_service_buf[4] = out_len;
	ipc_service_buf[5] = (uint32_t)&status;

	ret = send(ipc_service_buf, 7 * sizeof(uint32_t));

	if(ret != 0) {
		return PSA_ERROR_COMMUNICATION_FAILURE;
	}

    return status;
}
```
